## techpack/audio/asoc/codecs/tas256x/Kconfig
```kconfig
#
# TAS256X codec
#

menuconfig SND_SOC_TAS256X
    tristate "SND_SOC_TAS256X"
    default y

if SND_SOC_TAS256X

config TAS256X_CODEC
    tristate "TAS256X_CODEC"
    default y

config TAS256X_REGMAP
    tristate "TAS256X_REGMAP"
    default y

config TAS25XX_ALGO
    tristate "TAS25XX_ALGO"
    default y

endif
```
